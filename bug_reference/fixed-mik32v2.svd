# MIK32 register map
Vendor: Mikron; Series: MIK32; File version: 1.0
Registers are 32-bit, read-write, reset 0x0 unless marked. A register's access mark holds for its fields unless they carry their own. Offsets are from the block's base; [hi:lo] are bit positions.

## GPIO16_0 — Модуль ввода/вывода
Base 0x00084000
Same registers: GPIO16_1 0x00084400
0x00 SET wo — Установка выводов в «1»
0x00 STATE ro — Текущее состояние выводов
0x04 CLEAR wo — Текущее состояние прерываний / Установка «0» При чтении – текущее состояние запросов прерываний. При записи бита «1» соответствующий биту вывод устанавливается в «0»
0x08 DIRECTION_OUT reset 0xFFFF — Установка направления выводов как выход При чтении – текущее направление выводов: 0 – выход; 1 – вход. Запись «1» устанавливает соответствующий вывод как «выход»
0x0C DIRECTION_IN reset 0xFFFF — Установка направления выводов как вход При чтении – текущее направление выводов: 0 – выход; 1 – вход. Запись «1» устанавливает соответствующий вывод как «вход»
0x10 OUTPUT — Выходной регистр Чтение возвращает содержимое выходного регистра независимо от текущего направления выводов Запись устанавливает значения всех битов выходного регистра
0x14 CONTROL — Тестовый режим Запись «1» в [0:0] разряд – включение тестового режима (выходы замкнуты на входы внутри модуля) Запись «0» в [0:0] разряд – нормальный режим

## GPIO8_2 — Модуль ввода/вывода
Base 0x00084800
Registers as GPIO16_0; these are added or differ:
0x08 DIRECTION_OUT reset 0xFF — Установка направления выводов как выход При чтении – текущее направление выводов: 0 – выход; 1 – вход. Запись «1» устанавливает соответствующий вывод как «выход»
0x0C DIRECTION_IN reset 0xFF — Установка направления выводов как вход При чтении – текущее направление выводов: 0 – выход; 1 – вход. Запись «1» устанавливает соответствующий вывод как «вход»

## GPIO_IRQ — Модуль формирования прерываний
Base 0x00084C00
0x00 STATE ro — Текущее состояние выводов линий после мультисплексоров. Номер бита соответсвует номеру канала.
0x04 LINE_MUX — Управление мультиплексорами. Каждый мультиплесор управляется своими 4 битами: Mux_0 – [3:0]; Mux_1 – [7:4]; Mux_2 – [11:8]; Mux_3 – [15:12]; Mux_4 – [19:16]; Mux_5– [23:20]; Mux_6 – [27:24]; Mux_7 – [31:28]
0x08 INTERRUPT — Текущее состояние прерываний. Номер бита соответсвует номеру канала.
0x0C ENABLE_SET — Регистр разрешения прерываний При чтении – текущее состояние разрешений прерываний. При записи «1» разрешает прерывание от соответствующего канала.
0x10 ENABLE_CLEAR — Регистр запрета прерываний При чтении – текущее состояние разрешений прерываний. При записи «1» запрещает прерывание от соответствующего канала
0x14 EDGE — Регистр типа прерываний. При чтении – текущий тип прерывания: «1» – по событию (фронт или спад), «0» – по уровню. Запись «1» – прерывание формируется по событию для соответствующего канала Запись «0» - не влияет
0x18 LEVEL reset 0xFF — Регистр типа прерываний. При чтении – текущий тип прерывания (инвертированный): «0» – по событию; «1» – по уровню. Запись «1» – прерывание формируется по уровню для соответствующего канала Запись «0» - не влияет
0x1C LEVEL_SET — Регистр выбора уровня / события прерываний. При чтении: «0» – прерывания формируются по спаду или уровню логического «0»; «1» – прерывания формируются по нарастающему фронту или уровню логической «1» Запись «1» – прерывание формируется по нарастающему фронту или уровню логической «1» для соответствующего канала
0x20 LEVEL_CLEAR — Регистр уровня / со-бытия прерываний. При чтении: «0» – прерывания формируются по спаду или уровню логического «0»; «1» – прерывания формируются по нарастающему фронту или уровню логической «1» Запись «1»– прерывание формируется по спаду или уровню логического «0» для соответствующего канала
0x24 ANY_EDGE_SET — Регистр прерываний по любому событию. Запись «1» – прерывание формируется по любому изменению соответствующего канала
0x28 ANY_EDGE_CLEAR — Регистр прерываний по любому событию. Запись «1» – прерывание не формируется по любому изменению соответствующего канала
0x2C CLEAR wo write-1-clears — Регистр сброса флагов прерываний по событию. Запись «1» – очищает флаг прерывания соответствующего канала

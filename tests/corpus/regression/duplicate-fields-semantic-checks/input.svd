# D register map
File version: 1
Duplicate fields must not hide independent errors
Registers are 32-bit, access not given, no defined reset value unless marked. A register's access mark holds for its fields unless they carry their own. Offsets are from the block's base; lines under a group give offsets from that group; [hi:lo] are bit positions; {n}, {i} and the like mark numbered series; 'fields as' and 'values as' point back to an identical list; <NAME> marks a mode.

## Memory map
0x00001000 P size 0x4 — Peripheral

## P — Peripheral
Base 0x00001000
0x00 R
0x00 OTHER reset 0x100000000
  [32:31] Outside
0x04 OUTSIDE

# Derived register map
File version: 1.0
Device using derivedFrom, dim and cluster
Registers are 32-bit, read-write, no defined reset value unless marked. A register's access mark holds for its fields unless they carry their own. Offsets are from the block's base; lines under a group give offsets from that group; [hi:lo] are bit positions; {n}, {i} and the like mark numbered series; 'fields as' and 'values as' point back to an identical list; <NAME> marks a mode.

## Memory map
0x40020000 GPIOA — GPIO port A
0x40020400 GPIOB

## GPIOA — GPIO port A
Base 0x40020000
Same registers: GPIOB 0x40020400
{0x0+4i} DATA{i} (i=0..3) — Data registers
0x20 CFG group — Configuration cluster
  0x00 MODE
  {0x4+4j} CH{j} (j=0..1) — Channel registers

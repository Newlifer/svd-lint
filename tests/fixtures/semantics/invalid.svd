# InvalidSemantic register map
File version: 1
Independent semantic failures
Registers are 8-bit, read-write, reset 0x100 unless marked. A register's access mark holds for its fields unless they carry their own. Offsets are from the block's base; lines under a group give offsets from that group; [hi:lo] are bit positions; {n}, {i} and the like mark numbered series; 'fields as' and 'values as' point back to an identical list; <NAME> marks a mode.

## Memory map
0x00001000 P size 0x1

## P
Base 0x00001000
0x00 ZERO (reset mask 0x100)
  [0] ZERO
0x00 BAD ro reset 0x2 (reset mask 0x1) write-1-clears
  [8:7] OUT
  [6:5] E
    4=X; 1=X; 1=Y; other=D; other=E
  [4:3] B
  [3:0] A
  [1:0] WC range 3..2
0x00 LONG 16-bit (reset mask 0x100)
0x01 PARTIAL 16-bit (reset mask 0x100) (alternate view of MISSING)
0x08 RESET (reset mask 0x100)

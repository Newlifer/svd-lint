# Errors register map
File version: 1
Independent failures
Registers are 32-bit, access not given, no defined reset value unless marked. A register's access mark holds for its fields unless they carry their own. Offsets are from the block's base; lines under a group give offsets from that group; [hi:lo] are bit positions; {n}, {i} and the like mark numbered series; 'fields as' and 'values as' point back to an identical list; <NAME> marks a mode.

## Memory map
0x00000000 P
0xFFFFFFFFFFFFFFFF OVERFLOW

## P
Base 0x00000000
0x00 A
0x00 SELF
0x00 B
0x00 C
0x00 D
0x00 BAD{x} (x=A,A; step 0x4)
{0x0+4i} DOUBLE{i}{i} (i=0..1)
0x00 EMPTY%s

## OVERFLOW
Base 0xFFFFFFFFFFFFFFFF
0x01 R
